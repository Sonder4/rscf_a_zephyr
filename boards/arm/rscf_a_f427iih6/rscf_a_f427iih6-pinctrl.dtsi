#include <zephyr/dt-bindings/pinctrl/stm32-pinctrl.h>

&pinctrl {
  rscf_spi4_nss_pe4: rscf_spi4_nss_pe4 {
    pinmux = <STM32_PINMUX('E', 4, AF5)>;
    bias-disable;
  };

  rscf_spi4_miso_pe5: rscf_spi4_miso_pe5 {
    pinmux = <STM32_PINMUX('E', 5, AF5)>;
    bias-disable;
  };

  rscf_spi4_mosi_pe6: rscf_spi4_mosi_pe6 {
    pinmux = <STM32_PINMUX('E', 6, AF5)>;
    bias-disable;
  };
};
