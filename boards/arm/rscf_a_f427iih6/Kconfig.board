## boards/arm/rscf_a_f427iih6/Kconfig.board
```kconfig
config BOARD_RSCF_A_F427IIH6
  bool "RSCF A STM32F427IIH6 board"
  depends on SOC_STM32F427XX
```

## boards/arm/rscf_a_f427iih6/Kconfig.defconfig
```kconfig
if BOARD_RSCF_A_F427IIH6

config GPIO
  default y

config SERIAL
  default y

config PINCTRL
  default y

endif
```

## boards/arm/rscf_a_f427iih6/board.yml
```yaml
board:
  name: rscf_a_f427iih6
  full_name: RSCF A STM32F427IIH6
  vendor: ncurc
  socs:
    - name: stm32f427xx
```

## boards/arm/rscf_a_f427iih6/rscf_a_f427iih6_defconfig
```kconfig
CONFIG_ARM=y
CONFIG_CPU_CORTEX_M4=y
CONFIG_SOC_SERIES_STM32F4X=y
CONFIG_SOC_STM32F427XX=y
CONFIG_CLOCK_CONTROL=y
CONFIG_CLOCK_CONTROL_STM32_CUBE=y
CONFIG_GPIO=y
CONFIG_PINCTRL=y
CONFIG_SERIAL=y
CONFIG_CONSOLE=y
CONFIG_UART_CONSOLE=y
CONFIG_CAN=y
CONFIG_I2C=y
CONFIG_SPI=y
CONFIG_PWM=y
CONFIG_COUNTER=y
```

## dts/bindings/rscf/ncurc,rscf-a-board.yaml
```yaml
description: RSCF A board-level hardware manifest

compatible: "ncurc,rscf-a-board"

include: base.yaml

properties:
  console-uart:
    type: phandle
    required: true
  comm-uart:
    type: phandle
    required: true
  imu-uart:
    type: phandle
    required: true
  ext-mux-uart:
    type: phandle
    required: true
  can-primary:
    type: phandle
    required: true
  can-secondary:
    type: phandle
    required: true
  usb-device:
    type: phandle
    required: true
  status-led:
    type: phandle
    required: true
```

## dts/bindings/rscf/ncurc,rscf-buzzer.yaml
```yaml
description: RSCF buzzer driven by a PWM channel

compatible: "ncurc,rscf-buzzer"

include: base.yaml

properties:
  pwms:
    type: phandle-array
    required: true
  startup-frequency-hz:
    type: int
    default: 523
```

## dts/bindings/rscf/ncurc,rscf-dtof2510-group.yaml
```yaml
description: RSCF DTOF2510 logical sensor group

compatible: "ncurc,rscf-dtof2510-group"

include: base.yaml

properties:
  mux:
    type: phandle
    required: true
  channel-count:
    type: int
    default: 4
```

## dts/bindings/rscf/ncurc,rscf-ext-uart-mux.yaml
```yaml
description: RSCF external UART multiplexer

compatible: "ncurc,rscf-ext-uart-mux"

include: base.yaml

properties:
  uart:
    type: phandle
    required: true
  a-gpios:
    type: phandle-array
    required: true
  b-gpios:
    type: phandle-array
    required: true
  default-channel:
    type: int
    default: 0
  switch-settle-ms:
    type: int
    default: 1
```

## dts/bindings/rscf/ncurc,rscf-power-switch-bank.yaml
```yaml
description: RSCF controllable power switch bank

compatible: "ncurc,rscf-power-switch-bank"

include: base.yaml

properties:
  power-gpios:
    type: phandle-array
    required: true
  default-state-mask:
    type: int
    default: 0
```

## dts/bindings/rscf/ncurc,rscf-servo-pwm.yaml
```yaml
description: RSCF PWM servo endpoint

compatible: "ncurc,rscf-servo-pwm"

include: base.yaml

properties:
  pwms:
    type: phandle-array
    required: true
  min-angle-deg:
    type: int
    default: 0
  max-angle-deg:
    type: int
    default: 180
  default-angle-deg:
    type: int
    default: 10
  min-pulse-us:
    type: int
    default: 500
  max-pulse-us:
    type: int
    default: 2500
  control-step-deg:
    type: int
    default: 1
  control-period-ms:
    type: int
    default: 10
```

## modules/rscf/Kconfig
```kconfig
menu "RSCF Services"

config RSCF_EVENT_BUS
  bool "Enable RSCF event bus"
  default y

config RSCF_DAEMON_SERVICE
  bool "Enable RSCF daemon service"
  default y

config RSCF_HEALTH_SERVICE
  bool "Enable RSCF health service"
  default y

config RSCF_LED_STATUS
  bool "Enable RSCF LED status driver"
  default y

config RSCF_EXT_UART_MUX
  bool "Enable RSCF external UART mux driver"
  default y

config RSCF_BUZZER
  bool "Enable RSCF buzzer driver"
  default y

config RSCF_POWER_SWITCH
  bool "Enable RSCF power switch driver"
  default y

config RSCF_COMM_SERVICE
  bool "Enable RSCF communication service"
  default y

config RSCF_ROS_BACKEND_MICROROS
  bool "Use micro-ROS as ROS backend"
  default n

config RSCF_MICROROS_SERVICE
  bool "Enable RSCF micro-ROS service"
  default y
  depends on RSCF_ROS_BACKEND_MICROROS

config RSCF_MICROROS_SIM_MODE
  bool "Enable micro-ROS simulated odom/imu data"
  default y
  depends on RSCF_MICROROS_SERVICE

config RSCF_MICROROS_ODOM_RATE_HZ
  int "micro-ROS odom publish rate (Hz)"
  range 1 1000
  default 200
  depends on RSCF_MICROROS_SERVICE

config RSCF_MICROROS_CMD_RATE_HZ
  int "micro-ROS command loop rate (Hz)"
  range 1 1000
  default 200
  depends on RSCF_MICROROS_SERVICE

config RSCF_MICROROS_STATUS_RATE_HZ
  int "micro-ROS status publish rate (Hz)"
  range 1 1000
  default 20
  depends on RSCF_MICROROS_SERVICE

config RSCF_CHASSIS_SERVICE
  bool "Enable RSCF chassis service"
  default y

config RSCF_ROBOT_SERVICE
  bool "Enable RSCF robot service"
  default y

config RSCF_MOTOR_SERVICE
  bool "Enable RSCF motor service"
  default y

config RSCF_DTOF2510
  bool "Enable RSCF DTOF2510 service"
  default y

config RSCF_IMU_UART
  bool "Enable RSCF IMU UART bridge"
  default y

config RSCF_DEBUG_FAULT
  bool "Enable RSCF debug fault service"
  default n

endmenu
```

## profiles/Kconfig
```kconfig
menu "RSCF Profiles"

choice RSCF_PROFILE
  prompt "Active RSCF application profile"
  default RSCF_PROFILE_MINIMAL_BRINGUP

config RSCF_PROFILE_MINIMAL_BRINGUP
  bool "Minimal bring-up profile"

config RSCF_PROFILE_COMM
  bool "Communication validation profile"

config RSCF_PROFILE_CHASSIS
  bool "Chassis control profile"

config RSCF_PROFILE_FULL
  bool "Full system profile"

endchoice

endmenu
```

## west.yml
```yaml
manifest:
  version: "1.2"

  remotes:
    - name: zephyrproject
      url-base: https://github.com/zephyrproject-rtos

  projects:
    - name: zephyr
      remote: zephyrproject
      revision: v4.3.0
      path: zephyr
      import: false
      west-commands: scripts/west-commands.yml
    - name: cmsis
      remote: zephyrproject
      revision: 512cc7e895e8491696b61f7ba8066b4a182569b8
      path: third_party/hal/cmsis
    - name: hal_stm32
      remote: zephyrproject
      revision: 286dd285b5bb4fddafdfff27b5405264e5a61bfe
      path: third_party/hal/stm32
    - name: segger
      remote: zephyrproject
      revision: 9f08435a79d41133d7046b7c59d1b25929eda450
      path: modules/debug/segger

  self:
    path: manifest
```
